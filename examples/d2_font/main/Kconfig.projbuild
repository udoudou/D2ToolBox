## examples/d2_font/main/Kconfig.projbuild
```kconfig
menu "Example Configuration"

    choice EXAMPLE_FONT_TYPE
        prompt "Chinese font support"
        default EXAMPLE_FONT_IN_FW
        help
            ...

        config EXAMPLE_FONT_IN_FW
            bool "Build in fw"
        config EXAMPLE_FONT_IN_PARTITION
            bool "Put in a partition"
        config EXAMPLE_FONT_IN_MMAP_ASSETS
            bool "Put in a MMAP ASSETS"
    endchoice

endmenu
```

## examples/d2_font/sdkconfig.defaults
```kconfig
CONFIG_ESPTOOLPY_FLASHMODE_QIO=y

CONFIG_LV_CONF_SKIP=y
CONFIG_LV_USE_OBSERVER=y
CONFIG_LV_USE_SYSMON=y
CONFIG_LV_USE_FONT_COMPRESSED=y

CONFIG_PARTITION_TABLE_CUSTOM=y
```
